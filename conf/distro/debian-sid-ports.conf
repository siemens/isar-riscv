## conf/distro/debian-sid-ports.conf
```bitbake
# Copyright (c) Siemens AG, 2021
#
# Authors:
#  Guillaume Pais <guillaume.pais@siemens.com>
#  Steffen Gerhold <steffen.gerhold@siemens.com>
#
# This file is subject to the terms and conditions of the MIT License. See
# COPYING.MIT file in the top-level directory.
#

require ${LAYERDIR_core}/conf/distro/debian-sid-ports.conf

DEBIAN_PORTS_KEY = "https://www.ports.debian.org/archive_2021.key;sha256sum=44a0c59cac5385cd0a1506f695fbd2381fb71a04d8afc05248ad00a0ec6052aa"
```

## conf/layer.conf
```bitbake
# Copyright (c) Siemens AG, 2020
#
# Authors:
#  Jan Kiszka <jan.kiszka@siemens.com>
#
# This file is subject to the terms and conditions of the MIT License. See
# COPYING.MIT file in the top-level directory.
#

BBPATH .= ":${LAYERDIR}"

BBFILES += "${LAYERDIR}/recipes-*/*/*.bb \
        ${LAYERDIR}/recipes-*/*/*.bbappend"

BBFILE_COLLECTIONS += "isar-riscv"
BBFILE_PATTERN_isar-riscv = "^${LAYERDIR}/"
BBFILE_PRIORITY_isar-riscv = "6"

LAYERSERIES_COMPAT_isar-riscv = "next"

LAYERDIR_isar-riscv = "${LAYERDIR}"
```

## conf/machine/noelv.conf
```bitbake
# Copyright (c) Siemens AG, 2021
#
# Authors:
#  Steffen Gerhold <steffen.gerhold@siemens.com>
#
# This file is subject to the terms and conditions of the MIT License. See
# COPYING.MIT file in the top-level directory.
#

DISTRO_ARCH ?= "riscv64"

# build image that does not have a kernel
KERNEL_NAME=""

IMAGER_BUILD_DEPS += "opensbi-noelv"
PREFERRED_VERSION_opensbi = "0.8"

IMAGE_TYPE ?= "targz-img"

IMAGE_INSTALL += "isar-exclude-docs"

IMAGE_PREINSTALL += "dnsutils iproute2 iputils-ping net-tools sudo vim wget"

USERS += "riscv"
# password "riscv"
USER_riscv[password] = "$y$j9T$EchT3mSPeidsa1Tl4I4is1$iIPDNXuRgj8PTe/i5p2MKof0VJ/clnHEqJlWJVW.j7D"
USER_riscv[flags] += "create-home"
USER_riscv[shell] = "/bin/bash"
USER_riscv[groups] += "sudo"

IMAGE_INSTALL += "sshd-regen-keys"
```

## conf/machine/qemuriscv64.conf
```bitbake
# Copyright (c) Siemens AG, 2020-2021
#
# Authors:
#  Jan Kiszka <jan.kiszka@siemens.com>
#  Steffen Gerhold <steffen.gerhold@siemens.com>
#
# This file is subject to the terms and conditions of the MIT License. See
# COPYING.MIT file in the top-level directory.
#

require ${LAYERDIR_isar}/conf/machine/qemuriscv64.conf

IMAGER_BUILD_DEPS += "opensbi-qemu"

IMAGE_PREINSTALL += "dhcpcd5 dnsutils iproute2 iputils-ping net-tools sudo vim wget"

USERS += "riscv"
# password "riscv"
USER_riscv[password] = "$y$j9T$EchT3mSPeidsa1Tl4I4is1$iIPDNXuRgj8PTe/i5p2MKof0VJ/clnHEqJlWJVW.j7D"
USER_riscv[flags] += "create-home"
USER_riscv[shell] = "/bin/bash"
USER_riscv[groups] += "sudo"

IMAGE_INSTALL += "sshd-regen-keys"

ROOTFS_EXTRA = "1024"
```
